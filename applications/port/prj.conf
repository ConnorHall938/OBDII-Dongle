## CMakeLists.txt
```
#-------------------------------------------------------------------------------
# Zephyr Example Application
#
# Copyright (c) 2021 Nordic Semiconductor ASA
# SPDX-License-Identifier: Apache-2.0

cmake_minimum_required(VERSION 3.13.1)
find_package(Zephyr REQUIRED HINTS $ENV{ZEPHYR_BASE})

project(app LANGUAGES C)

add_subdirectory(src)

# The code below locates the git index file for this repository and adds it as a dependency for
# the application VERSION file so that if the repo has a new commit added, even if no files in
# the build have changed, the application version file will be regenerated with the new git commit
find_package(Git QUIET)
if(GIT_FOUND)
  execute_process(
    COMMAND ${GIT_EXECUTABLE} rev-parse --absolute-git-dir
    WORKING_DIRECTORY .
    OUTPUT_VARIABLE application_git_dir
    OUTPUT_STRIP_TRAILING_WHITESPACE
    ERROR_STRIP_TRAILING_WHITESPACE
    ERROR_VARIABLE stderr
    RESULT_VARIABLE return_code
  )
  # If there is an error e.g. it is not a git repo, we just silently ignore it and continue
  # without a dependency, this will be the case with freestanding applications.
  if(NOT return_code)
    if(NOT "${stderr}" STREQUAL "")
      message(WARNING "Application build version git rev-parse warned: ${stderr}")
    endif()

    set_property(TARGET app_version_h PROPERTY APP_VERSION_DEPENDS ${application_git_dir}/index)
  endif()
endif()
```

## Kconfig
```
# Copyright (c) 2021 Nordic Semiconductor ASA
# SPDX-License-Identifier: Apache-2.0
#
# This file is the application Kconfig entry point. All application Kconfig
# options can be defined here or included via other application Kconfig files.
# You can browse these options using the west targets menuconfig (terminal) or
# guiconfig (GUI).

menu "Zephyr"
source "Kconfig.zephyr"
endmenu

module = APP
module-str = APP
source "subsys/logging/Kconfig.template.log_config"

config APP_BT_CORE_INIT_PRIORITY
    int "Init priority of bluetooth core system"
    default 10

config APP_BT_FINAL_INIT_PRIORITY
    int "Final bluetooth step - Starts advertising and accepting connections"
    default 90

config APP_BT_NUS_INIT_PRIORITY
    int "Init priority of bluetooth NUS system"
    default 11

config APP_BT_OBD_INIT_PRIORITY
    int "Init priority of bluetooth OBD system"
    default 12

config APP_CAN_INIT_PRIORITY
    int "Init priority of CAN system"
    default 10

config APP_OBD_INIT_PRIORITY
    int "Init priority of OBD system"
    default 11

config APP_DATABASE_INIT_PRIORITY
    int "Init priority of database system"
    default 10
```

## prj.conf
```kconfig
# Copyright (c) 2021 Nordic Semiconductor ASA
# SPDX-License-Identifier: Apache-2.0
#
# This file contains selected Kconfig options for the application.

CONFIG_LED=y
CONFIG_LED_GPIO=y

# compiler
#CONFIG_DEBUG_OPTIMIZATIONS=y

# logging
CONFIG_LOG=y
#CONFIG_LOG_MODE_IMMEDIATE=y
CONFIG_APP_LOG_LEVEL_DBG=y

# --- core ---
CONFIG_BT=y
CONFIG_BT_PERIPHERAL=y
CONFIG_BT_ZEPHYR_NUS=y
CONFIG_BT_DEVICE_NAME="CAN-BLE"

# --- throughput ---
CONFIG_BT_EXT_ADV=y
CONFIG_BT_AUTO_PHY_PERIPHERAL_2M=y
# DLE: 27 -> 251 byte link-layer PDUs
CONFIG_BT_AUTO_DATA_LEN_UPDATE=y

CONFIG_BT_L2CAP_TX_MTU=247
CONFIG_BT_BUF_ACL_TX_SIZE=251
CONFIG_BT_BUF_ACL_RX_SIZE=251
# queue depth for bursts
CONFIG_BT_L2CAP_TX_BUF_COUNT=16
CONFIG_BT_ATT_PREPARE_COUNT=4
CONFIG_BT_CONN_TX_MAX=16

# NUS
CONFIG_BT_ZEPHYR_NUS=y


# --- stack sizing ---
# CONFIG_LOG_MODE_IMMEDIATE formats each message on the *calling* thread's
# stack (cbprintf packaging + log_output backend). The BT host threads run at
# the defaults sized for deferred logging, so the RX workqueue overflowed
# rx_thread_stack and smashed the thread stack placed immediately below it in
# .bss (bt_tx_processor_stack). Give every thread that logs real headroom.
# CONFIG_BT_RX_STACK_SIZE=2048
# CONFIG_BT_TX_PROCESSOR_STACK_SIZE=2048
# CONFIG_BT_LONG_WQ_STACK_SIZE=2048
# CONFIG_SYSTEM_WORKQUEUE_STACK_SIZE=2048

# --- stack overflow diagnostics (drop once tuned) ---
# STACK_SENTINEL turns a silent neighbour-stack smash into a loud kernel panic
# naming the offending thread; THREAD_ANALYZER reports high-water marks.
CONFIG_INIT_STACKS=y
CONFIG_STACK_SENTINEL=y
CONFIG_THREAD_ANALYZER=y
CONFIG_THREAD_ANALYZER_USE_PRINTK=y
# CONFIG_THREAD_ANALYZER_AUTO=y
# CONFIG_THREAD_ANALYZER_AUTO_INTERVAL=30
```

## boards/esp32s3_devkitc_esp32s3_procpu.overlay
```dts
/*
 * Copyright (c) 2021 Nordic Semiconductor ASA
 * SPDX-License-Identifier: Apache-2.0
 */

/* This devicetree overlay file will be automatically picked by the Zephyr
 * build system when building the sample for the esp32s3_devkitc board. The
 * board does not define any LED, so one is described here for the LED API.
 */

/ {
	leds {
		compatible = "gpio-leds";

		led0: led_0 {
			gpios = <&gpio0 1 GPIO_ACTIVE_HIGH>;
			label = "Blink LED";
		};
	};

	aliases {
		led0 = &led0;
	};
};
```

## src/main.c
```c
/*
 * Copyright (c) 2021 Nordic Semiconductor ASA
 * SPDX-License-Identifier: Apache-2.0
 */

#include <zephyr/kernel.h>
#include <zephyr/drivers/led.h>
#include <zephyr/logging/log.h>

#include <zephyr/app_version.h>


LOG_MODULE_REGISTER(main, CONFIG_APP_LOG_LEVEL);

#define BLINK_PERIOD_MS 1000U


int main(void)
{
	int ret;
	static const struct led_dt_spec led = LED_DT_SPEC_GET(DT_ALIAS(led0));

	if (!led_is_ready_dt(&led)) {
		LOG_ERR("LED not ready");
		return 0;
	}

	printk("Blinking LED every %u ms\n", BLINK_PERIOD_MS);

	while (1) {
		ret = led_on_dt(&led);
		if (ret < 0) {
			LOG_ERR("Could not turn on LED (%d)", ret);
			return 0;
		}

		k_sleep(K_MSEC(BLINK_PERIOD_MS / 2U));
		ret = led_off_dt(&led);
		if (ret < 0) {
			LOG_ERR("Could not turn off LED (%d)", ret);
			return 0;
		}

		k_sleep(K_MSEC(BLINK_PERIOD_MS / 2U));
	}

	return 0;
}
```
